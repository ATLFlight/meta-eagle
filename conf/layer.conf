## conf/layer.conf
```bitbake
# We have a conf and classes directory, add to BBPATH
BBPATH .= ":${LAYERDIR}"

# We have a packages directory, add to BBFILES
BBFILES += "${LAYERDIR}/recipes-*/*/*.bb \
            ${LAYERDIR}/recipes-*/*/*.bbappend"

BBFILE_COLLECTIONS += "eagle-linux"
BBFILE_PATTERN_eagle-linux := "^${LAYERDIR}/"
BBFILE_PRIORITY_eagle-linux = "6"

# Add our custom license directory
LICENSE_PATH += "${LAYERDIR}/files/custom-licenses"
```
